## config/boards/shields/nivata/Kconfig.defconfig
```kconfig
if SHIELD_NIVATA_LEFT

config ZMK_KEYBOARD_NAME
    default "Nivata"

config ZMK_SPLIT_ROLE_CENTRAL
    default y

endif

if SHIELD_NIVATA_LEFT || SHIELD_NIVATA_RIGHT

config ZMK_SPLIT
    default y

endif
```

## config/boards/shields/nivata/Kconfig.shield
```kconfig
config SHIELD_NIVATA_LEFT
    def_bool $(shields_list_contains,nivata_left)

config SHIELD_NIVATA_RIGHT
    def_bool $(shields_list_contains,nivata_right)
```
