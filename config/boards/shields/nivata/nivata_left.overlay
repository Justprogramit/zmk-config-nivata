#include "nivata.dtsi"

&kscan0 {
        col-gpios =
        <&gpio1 4 GPIO_ACTIVE_LOW>,
        <&gpio0 11 GPIO_ACTIVE_LOW>,
        <&gpio1 0 GPIO_ACTIVE_LOW>,
        <&gpio0 24 GPIO_ACTIVE_LOW>,
        <&gpio0 22 GPIO_ACTIVE_LOW>,
        <&gpio0 20 GPIO_ACTIVE_LOW>,
        <&gpio1 15 GPIO_ACTIVE_LOW>,
        <&gpio1 13 GPIO_ACTIVE_LOW>,
        <&gpio1 11 GPIO_ACTIVE_LOW>,
        <&gpio0 10 GPIO_ACTIVE_LOW>; 
};

